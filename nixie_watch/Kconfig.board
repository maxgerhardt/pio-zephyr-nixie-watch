## nixie_watch/Kconfig.board
```kconfig
# nRF52 DK NRF52832 board configuration

# Copyright (c) 2016 Nordic Semiconductor ASA
# SPDX-License-Identifier: Apache-2.0

config BOARD_NIXIE_WATCH
	bool "Nixie watch board"
	depends on SOC_NRF52832_QFAA
```

## nixie_watch/Kconfig.defconfig
```kconfig
# nRF52 DK NRF52832 board configuration

# Copyright (c) 2016 Nordic Semiconductor ASA
# SPDX-License-Identifier: Apache-2.0

if BOARD_NIXIE_WATCH

config BOARD
	default "nixie_watch"

config BT_CTLR
	default BT

endif # BOARD_NIXIE_WATCH
```
